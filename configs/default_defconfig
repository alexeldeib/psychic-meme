## configs/default_defconfig
```kconfig
BR2_x86_64=y
BR2_KERNEL_HEADERS_6_1=y
BR2_ROOTFS_OVERLAY="$(BR2_EXTERNAL_FIRE_PATH)/board/fire/rootfs-overlay/"
BR2_ROOTFS_POST_FAKEROOT_SCRIPT="$(BR2_EXTERNAL_FIRE_PATH)/board/fire/post-image.sh"
BR2_LINUX_KERNEL=y
BR2_LINUX_KERNEL_USE_ARCH_DEFAULT_CONFIG=y
BR2_LINUX_KERNEL_VMLINUX=y
BR2_PACKAGE_DROPBEAR=y
BR2_PACKAGE_IPROUTE2=y
BR2_PACKAGE_NANO=y
BR2_TARGET_ROOTFS_EXT2=y
BR2_TARGET_ROOTFS_EXT2_4=y
BR2_TARGET_ROOTFS_EXT2_SIZE="10M"
BR2_TARGET_ROOTFS_OCI=y
BR2_TARGET_ROOTFS_SQUASHFS=y
# BR2_TARGET_ROOTFS_TAR is not set
```
